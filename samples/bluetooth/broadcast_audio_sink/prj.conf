## CMakeLists.txt
```
# SPDX-License-Identifier: Apache-2.0

cmake_minimum_required(VERSION 3.20.0)
find_package(Zephyr REQUIRED HINTS $ENV{ZEPHYR_BASE})
project(unicast_audio_server)

target_sources(app PRIVATE
  src/main.c
)

zephyr_library_include_directories(
  ${ZEPHYR_BASE}/samples/bluetooth
  src/audio
  src/modules
)

add_subdirectory(src/audio)
add_subdirectory(src/drivers)
add_subdirectory(src/modules)
```

## Kconfig
```
#
# Copyright (c) 2022 Nordic Semiconductor ASA
#
# SPDX-License-Identifier: LicenseRef-Nordic-5-Clause
#

mainmenu "Bluetooth: Broadcast Audio Sink"

config MAIN_THREAD_PRIORITY
	int
	default 10

config MAIN_STACK_SIZE
	int
	default 3616

config SYSTEM_WORKQUEUE_STACK_SIZE
	int
	default 4096

config THREAD_NAME
	bool
	default y

config HW_CODEC_CIRRUS_LOGIC
	bool
	default y

config NRFX_I2S
	bool
	default y

config NRFX_I2S0
	bool
	default y

config NRFX_CLOCK
	bool
	default y

config NRFX_TIMER1
	bool
	default y

#----------------------------------------------------------------------------#
menu "Bluetooth"

choice BT_AUDIO_BROADCAST_BAP_CONFIGURATION
	prompt "Broadcast codec configuration"
	default BT_BAP_BROADCAST_16_2_1
	help
	  Select the broadcast codec configuration as given
	  in Table 6.4 of the BAP specification.
	  USB only supports 48 kHz samplig rate.

config BT_BAP_BROADCAST_16_2_1
	bool "16_2_1"
	help
	  Broadcast mandatory codec capability 16_2_1
	  16kHz, 32kbps, 2 retransmits, 10ms transport latency, and 40ms presentation delay.

config BT_BAP_BROADCAST_24_2_1
	bool "24_2_1"
	help
	  Broadcast codec capability 24_2_1
	  24kHz, 48kbps, 2 retransmits, 10ms transport latency, and 40ms presentation delay.

config BT_BAP_BROADCAST_16_2_2
	bool "16_2_2"
	help
	  Broadcast mandatory codec capability 16_2_2
	  16kHz, 32kbps, 4 retransmits, 60ms transport latency, and 40ms presentation delay.

config BT_BAP_BROADCAST_24_2_2
	bool "24_2_2"
	help
	  Broadcast codec capability 24_2_2
	  24kHz, 48kbps, 4 retransmits, 60ms transport latency, and 40ms presentation delay.
endchoice

endmenu # Bluetooth

#----------------------------------------------------------------------------#
menu "Audio"

choice AUDIO_FRAME_DURATION
	prompt "Select frame duration"
	default AUDIO_FRAME_DURATION_10_MS
	help
	  LC3 supports frame duration of 7.5 and 10 ms.

config AUDIO_FRAME_DURATION_7_5_MS
	bool "7.5 ms"

config AUDIO_FRAME_DURATION_10_MS
	bool "10 ms"
endchoice

config AUDIO_FRAME_DURATION_US
	int
	default 7500 if AUDIO_FRAME_DURATION_7_5_MS
	default 10000 if AUDIO_FRAME_DURATION_10_MS
	help
	  Audio frame duration in µs.

choice AUDIO_SAMPLE_RATE
	prompt "Audio sample rate"
	default AUDIO_SAMPLE_RATE_16000_HZ if BT_BAP_BROADCAST_16_2_1 || BT_BAP_BROADCAST_16_2_2 || BT_BAP_UNICAST_16_2_1
	default AUDIO_SAMPLE_RATE_24000_HZ if BT_BAP_BROADCAST_24_2_1 || BT_BAP_BROADCAST_24_2_2 || BT_BAP_UNICAST_24_2_1
	default AUDIO_SAMPLE_RATE_48000_HZ
	help
	  This will be selected based on the BAP settings.

config AUDIO_SAMPLE_RATE_16000_HZ
	bool "16 kHz"
	help
	  Sample rate of 16kHz.

config AUDIO_SAMPLE_RATE_24000_HZ
	bool "24 kHz"
	help
	  Sample rate of 24kHz.

config AUDIO_SAMPLE_RATE_48000_HZ
	bool "48 kHz"
	help
	  Sample rate of 48kHz.
endchoice

config AUDIO_SAMPLE_RATE_HZ
	int
	default 16000 if AUDIO_SAMPLE_RATE_16000_HZ
	default 24000 if AUDIO_SAMPLE_RATE_24000_HZ
	default 48000 if AUDIO_SAMPLE_RATE_48000_HZ
	help
	  I2S supports 16, 24, and 48 kHz sample rates for both input and output.
	  USB supports only 48 kHz for input.

choice AUDIO_BIT_DEPTH
	prompt "Audio bit depth"
	default AUDIO_BIT_DEPTH_16
	help
	  Select the bit depth for audio.

config AUDIO_BIT_DEPTH_16
	bool "16 bit audio"

config AUDIO_BIT_DEPTH_32
	bool "32 bit audio"
endchoice

config AUDIO_BIT_DEPTH_BITS
	int
	default 16 if AUDIO_BIT_DEPTH_16
	default 32 if AUDIO_BIT_DEPTH_32
	help
	  Bit depth of one sample in storage.

config AUDIO_BIT_DEPTH_OCTETS
	int
	default 2 if AUDIO_BIT_DEPTH_16
	default 4 if AUDIO_BIT_DEPTH_32
	help
	  Bit depth of one sample in storage given in octets.

choice AUDIO_CODEC_DEFAULT
	prompt "Audio codec"
	default CODEC_LC3
	help
	  Select the default codec to use on start up.

config CODEC_LC3
	bool "LC3"
	select SW_CODEC_LC3_T2_SOFTWARE
	help
	  LC3 is the mandatory codec for LE Audio.
endchoice

endmenu # Audio

#----------------------------------------------------------------------------#
menu "I2S"

config I2S_LRCK_FREQ_HZ
	int
	default AUDIO_SAMPLE_RATE_HZ
	help
	 The sample rate of I2S. For now this is tied directly to
	 AUDIO_SAMPLE_RATE_HZ
	 Note that this setting is only valid in I2S master mode.

config I2S_CH_NUM
	int
	default 2
	help
	 The I2S driver itself supports both mono and stereo.
	 Parts of the implementation are configured for only stereo.

endmenu # I2S

#----------------------------------------------------------------------------#
menu "FIFO"

config FIFO_FRAME_SPLIT_NUM
	int "Number of blocks to make up one frame of audio data"
	default 10
	help
	  Easy DMA in I2S requires two buffers to be filled before I2S
	  transmission will begin. In order to reduce latency, an audio
	  frame can be split into multiple blocks with this parameter. USB
	  sends data in 1 ms blocks, so we need the split to match that.
	  Since we set frame size to 10 ms for USB, 10 is selected as
	  FRAME_SPLIT_NUM

endmenu # FIFO

source "Kconfig.zephyr"
```

## prj.conf
```kconfig
CONFIG_BT=y
CONFIG_BT_DEVICE_NAME="Broadcast Audio Sink"
CONFIG_BT_AUDIO=y
CONFIG_BT_SMP=y
CONFIG_BT_PAC_SNK=y
CONFIG_BT_PERIPHERAL=y
CONFIG_BT_AUDIO_BROADCAST_SINK=y

CONFIG_FPU=y
CONFIG_LIBLC3=y
CONFIG_NEWLIB_LIBC=y

CONFIG_DISK_ACCESS=y
CONFIG_FILE_SYSTEM=y
CONFIG_FAT_FILESYSTEM_ELM=y
```

## src/main.c
```c
/*
 * Copyright (c) 2022 Nordic Semiconductor ASA
 *
 * SPDX-License-Identifier: Apache-2.0
 * 
 * This file contains parts of the Zephyr RTOS repository
 * as well as the nrf-sdk repository on GitHub.
 * 
 */

#include <zephyr/bluetooth/bluetooth.h>
#include <zephyr/bluetooth/audio/audio.h>
#include <zephyr/bluetooth/audio/pacs.h>
#include <zephyr/ipc/ipc_service.h>
#include <zephyr/drivers/gpio.h>
#include "audio_i2s.h"
#include "hw_codec.h"
#include "lc3.h"

#define SEM_TIMEOUT K_SECONDS(10)
#define CHANNEL_MAP_SIZE 5

#define NEXT_IDX(i) (((i) < (80 - 1)) ? ((i) + 1) : 0)
#define PREV_IDX(i) (((i) > 0) ? ((i)-1) : (80 - 1))

#define BLK_PERIOD_US 1000
#define NUM_BLKS(d) ((d) / BLK_PERIOD_US)
#define BLK_SIZE_SAMPLES(r) (((r)*BLK_PERIOD_US) / 1000000)
#define NUM_BLKS_IN_FRAME NUM_BLKS(CONFIG_AUDIO_FRAME_DURATION_US)
#define BLK_MONO_NUM_SAMPS BLK_SIZE_SAMPLES(CONFIG_AUDIO_SAMPLE_RATE_HZ)
#define BLK_STEREO_NUM_SAMPS (BLK_MONO_NUM_SAMPS * 2)
#define BLK_MONO_SIZE_OCTETS (BLK_MONO_NUM_SAMPS * CONFIG_AUDIO_BIT_DEPTH_OCTETS)
#define BLK_STEREO_SIZE_OCTETS (BLK_MONO_SIZE_OCTETS * 2)

#define FRAME_SIZE_BYTES_MONO 160 * 2 // TODO: change to codec setting
#define FRAME_SIZE_BYTES_STEREO FRAME_SIZE_BYTES_MONO * 2

static K_SEM_DEFINE(sem_broadcaster_found, 0U, 1U);
static K_SEM_DEFINE(sem_pa_synced, 0U, 1U);
static K_SEM_DEFINE(sem_base_received, 0U, 1U);
static K_SEM_DEFINE(sem_syncable, 0U, 1U);
static K_SEM_DEFINE(sem_pa_sync_lost, 0U, 1U);

static struct bt_audio_broadcast_sink *broadcast_sink;
static struct bt_audio_stream streams[CONFIG_BT_AUDIO_BROADCAST_SNK_STREAM_COUNT];
static struct bt_codec codec = BT_CODEC_LC3_CONFIG_16_2(BT_AUDIO_LOCATION_FRONT_LEFT,
							BT_AUDIO_CONTEXT_TYPE_UNSPECIFIED);
static const uint32_t bis_index_mask = BIT_MASK(ARRAY_SIZE(streams) + 1U);
static uint32_t bis_index_bitfield;
static lc3_decoder_t lc3_decoder;
static lc3_decoder_mem_16k_t lc3_decoder_mem;
static int frames_per_sdu;
static int16_t audio_buf[160];
static int32_t start_i2s_out = 10;
static int16_t __aligned(sizeof(uint32_t)) fifo[2560];
static uint16_t prod_blk_idx = 0;
static uint16_t cons_blk_idx = 0;
static bool streaming = false;

static const struct gpio_dt_spec led_blue = GPIO_DT_SPEC_GET(DT_ALIAS(led2), gpios);
static const struct gpio_dt_spec led_red = GPIO_DT_SPEC_GET(DT_ALIAS(led0), gpios);

static void bound_cb(void *priv) {}
static void recv_cb(const void *data, size_t len, void *priv)
{
	if (len == CHANNEL_MAP_SIZE) {
		uint8_t *channel_map = (uint8_t*)data;
		printk("ChM: %x%x%x%x%x\n", channel_map[0], channel_map[1], channel_map[2], channel_map[3], channel_map[4]);

		if (channel_map[0] != 0xff) {
			gpio_pin_set_dt(&led_blue, 0);
			gpio_pin_set_dt(&led_red, 1);
		}
	}
}

static struct ipc_ept_cfg ept0_cfg = {
   .name = "ept0",
   .cb = {
      .bound    = bound_cb,
      .received = recv_cb,
   },
};

static void stream_started_cb(struct bt_audio_stream *stream)
{
	printk("Stream %p started\n", stream);
	gpio_pin_set_dt(&led_blue, 1);
	streaming = true;
}

static void stream_stopped_cb(struct bt_audio_stream *stream)
{
	printk("Stream %p stopped\n", stream);
	gpio_pin_set_dt(&led_blue, 0);
	gpio_pin_set_dt(&led_red, 0);
	streaming = false;
}

int pscm_zero_pad(void const *const input, size_t input_size,
		  uint8_t pcm_bit_depth, void *output, size_t *output_size)
{
	uint8_t bytes_per_sample = pcm_bit_depth / 8;

	char *pointer_input = (char *)input;
	char *pointer_output = (char *)output;

	for (uint32_t i = 0; i < input_size / bytes_per_sample; i++) {
		for (uint8_t j = 0; j < bytes_per_sample; j++) {
			*pointer_output++ = *pointer_input++;
		}

		for (uint8_t j = 0; j < bytes_per_sample; j++) {
			*pointer_output++ = 0;
		}
	}

	*output_size = input_size * 2;
	return 0;
}

static void stream_recv_cb(struct bt_audio_stream *stream,
			   const struct bt_iso_recv_info *info,
			   struct net_buf *buf)
{
	const uint8_t *in_buf;
	uint8_t err = -1;
	int octets_per_frame = buf->len / frames_per_sdu; // 40

	if (lc3_decoder == NULL) {
		printk("LC3 decoder not setup, cannot decode data.\n");
		return;
	}

	if (!(info->flags & BT_ISO_FLAGS_VALID)) {
		in_buf = NULL;
	} else {
		in_buf = buf->data;
	}

	memset(audio_buf, 0, FRAME_SIZE_BYTES_MONO);
	err = lc3_decode(lc3_decoder, in_buf, octets_per_frame, LC3_PCM_FORMAT_S16, audio_buf, 1);
	if (err < 0) { // 1 = PLC performed
		printk("LC3 decoder failed.\n");
	}

	static int16_t pcm_data_stereo[FRAME_SIZE_BYTES_STEREO];
	memset(pcm_data_stereo, 0, FRAME_SIZE_BYTES_STEREO);
	size_t pcm_size_stereo = 0;
	err = pscm_zero_pad(audio_buf, FRAME_SIZE_BYTES_MONO, CONFIG_AUDIO_BIT_DEPTH_BITS,
				pcm_data_stereo, &pcm_size_stereo);
	if (err) {
		printk("PSCM zero pad failed.\n");
		return;
	}

	for (uint32_t i = 0; i < NUM_BLKS_IN_FRAME; i++) {
		if (IS_ENABLED(CONFIG_AUDIO_BIT_DEPTH_16)) {
			memcpy(&fifo[prod_blk_idx * BLK_STEREO_NUM_SAMPS],
			       &((int16_t *)pcm_data_stereo)[i * BLK_STEREO_NUM_SAMPS],
			       BLK_STEREO_SIZE_OCTETS);
		} else if (IS_ENABLED(CONFIG_AUDIO_BIT_DEPTH_32)) {
			memcpy(&fifo[prod_blk_idx * BLK_STEREO_NUM_SAMPS],
			       &((int32_t *)pcm_data_stereo)[i * BLK_STEREO_NUM_SAMPS],
			       BLK_STEREO_SIZE_OCTETS);
		}
		prod_blk_idx = NEXT_IDX(prod_blk_idx);
	}

	if (start_i2s_out == 0) {
		static int16_t tx_buf_one[32] = { 0 };
		static int16_t tx_buf_two[32] = { 0 };
		audio_i2s_start((uint8_t *)tx_buf_one, NULL);
		audio_i2s_set_next_buf((uint8_t *)tx_buf_two, NULL);
	} else {
		start_i2s_out--;
	}
}

static struct bt_audio_stream_ops stream_ops = {
	.started = stream_started_cb,
	.stopped = stream_stopped_cb,
	.recv = stream_recv_cb
};

static bool scan_recv_cb(const struct bt_le_scan_recv_info *info,
			 struct net_buf_simple *ad,
			 uint32_t broadcast_id)
{
	k_sem_give(&sem_broadcaster_found);

	return true;
}

static void scan_term_cb(int err)
{
	if (err != 0) {
		printk("Scan terminated with error: %d\n", err);
	}
}

static void pa_synced_cb(struct bt_audio_broadcast_sink *sink,
			 struct bt_le_per_adv_sync *sync,
			 uint32_t broadcast_id)
{
	if (broadcast_sink != NULL) {
		printk("Unexpected PA sync\n");
		return;
	}

	printk("PA synced for broadcast sink %p with broadcast ID 0x%06X\n",
	       sink, broadcast_id);

	broadcast_sink = sink;

	k_sem_give(&sem_pa_synced);
}

static void base_recv_cb(struct bt_audio_broadcast_sink *sink,
			 const struct bt_audio_base *base)
{
	uint32_t base_bis_index_bitfield = 0U;

	if (k_sem_count_get(&sem_base_received) != 0U) {
		return;
	}

	printk("Received BASE with %u subgroups from broadcast sink %p\n",
	       base->subgroup_count, sink);

	for (size_t i = 0U; i < base->subgroup_count; i++) {
		for (size_t j = 0U; j < base->subgroups[i].bis_count; j++) {
			const uint8_t index = base->subgroups[i].bis_data[j].index;

			base_bis_index_bitfield |= BIT(index);
		}
	}

	bis_index_bitfield = base_bis_index_bitfield & bis_index_mask;

	k_sem_give(&sem_base_received);
}

static void syncable_cb(struct bt_audio_broadcast_sink *sink, bool encrypted)
{
	if (encrypted) {
		printk("Cannot sync to encrypted broadcast source\n");
		return;
	}

	k_sem_give(&sem_syncable);
}

static void pa_sync_lost_cb(struct bt_audio_broadcast_sink *sink)
{
	if (broadcast_sink == NULL) {
		printk("Unexpected PA sync lost\n");
		return;
	}

	printk("Sink %p disconnected\n", sink);

	broadcast_sink = NULL;

	streaming = false;
}

static struct bt_audio_broadcast_sink_cb broadcast_sink_cbs = {
	.scan_recv = scan_recv_cb,
	.scan_term = scan_term_cb,
	.base_recv = base_recv_cb,
	.syncable = syncable_cb,
	.pa_synced = pa_synced_cb,
	.pa_sync_lost = pa_sync_lost_cb
};

static struct bt_pacs_cap cap = {
	.codec = &codec,
};

static int init(void)
{
	int err;

	err = bt_enable(NULL);
	if (err) {
		printk("Bluetooth enable failed (err %d)\n", err);
		return err;
	}

	printk("Bluetooth initialized\n");

	err = bt_pacs_cap_register(BT_AUDIO_DIR_SINK, &cap);
	if (err) {
		printk("Capability register failed (err %d)\n", err);
		return err;
	}

	bt_audio_broadcast_sink_register_cb(&broadcast_sink_cbs);

	for (size_t i = 0U; i < ARRAY_SIZE(streams); i++) {
		streams[i].ops = &stream_ops;
	}

	return 0;
}

static void reset(void)
{
	int err;

	bis_index_bitfield = 0U;

	k_sem_reset(&sem_broadcaster_found);
	k_sem_reset(&sem_pa_synced);
	k_sem_reset(&sem_base_received);
	k_sem_reset(&sem_syncable);
	k_sem_reset(&sem_pa_sync_lost);

	if (broadcast_sink != NULL) {
		err = bt_audio_broadcast_sink_delete(broadcast_sink);
		if (err) {
			printk("Deleting broadcast sink failed (err %d)\n", err);
			return;
		}

		broadcast_sink = NULL;
	}
}

static void init_lc3(void)
{
	const int freq = bt_codec_cfg_get_freq(&codec);
	const int frame_duration_us = bt_codec_cfg_get_frame_duration_us(&codec);

	if (freq < 0) {
		printk("Error: Codec frequency not set, cannot start codec.");
	}

	if (frame_duration_us < 0) {
		printk("Error: Frame duration not set, cannot start codec.");
	}

	frames_per_sdu = bt_codec_cfg_get_frame_blocks_per_sdu(&codec, true);

	lc3_decoder = lc3_setup_decoder(frame_duration_us, freq,
					freq, &lc3_decoder_mem);

	if (lc3_decoder == NULL) {
		printk("ERROR: Failed to setup LC3 encoder - wrong parameters?\n");
	}
}

static uint16_t no_stream_ttl = 5000; // 500 packets = 1s

static void audio_datapath_i2s_blk_complete(uint32_t frame_start_ts, uint32_t *rx_buf_released,
					    uint32_t const *tx_buf_released)
{
	if(!streaming) {
		memset(fifo, 0, 2560*2);

		if(no_stream_ttl-- <= 0) {
			NVIC_SystemReset(); // reset board
		}
	}

	static uint8_t *tx_buf;
	uint32_t next_out_blk_idx = NEXT_IDX(cons_blk_idx);
	tx_buf = (uint8_t *)&fifo[next_out_blk_idx * 32];
	audio_i2s_set_next_buf(tx_buf, NULL);
	cons_blk_idx = next_out_blk_idx;
}

void main(void)
{
	struct bt_audio_stream *streams_p[ARRAY_SIZE(streams)];
	const struct device *inst0;
	struct ipc_ept ept0;
	int err;

	inst0 = DEVICE_DT_GET(DT_NODELABEL(ipc0));
	err = ipc_service_open_instance(inst0);
	err = ipc_service_register_endpoint(inst0, &ept0, &ept0_cfg);

	err = init();
	if (err) {
		printk("Init failed (err %d)\n", err);
		return;
	}

	if (!gpio_is_ready_dt(&led_blue) || !gpio_is_ready_dt(&led_red)) {
		printk("Init LEDs failed (err %d)\n", err);
		return;
	}

	err = gpio_pin_configure_dt(&led_blue, GPIO_OUTPUT_INACTIVE);
	err |= gpio_pin_configure_dt(&led_red, GPIO_OUTPUT_INACTIVE);
	if (err < 0) {
		return;
	}

	init_lc3();
	audio_i2s_blk_comp_cb_register(audio_datapath_i2s_blk_complete);
	audio_i2s_init();

	err = hw_codec_init();
	if (err) {
		printk("hw_codec_init failed\n");
	}

	err = hw_codec_default_conf_enable();
	if (err) {
		printk("hw_codec_default_conf_enable failed\n");
	}

	static int16_t tx_buf_one[32] = { 0 };
	static int16_t tx_buf_two[32] = { 0 };
	audio_i2s_start((uint8_t *)tx_buf_one, NULL);
	audio_i2s_set_next_buf((uint8_t *)tx_buf_two, NULL);

	for (size_t i = 0U; i < ARRAY_SIZE(streams_p); i++) {
		streams_p[i] = &streams[i];
	}

	while (true) {
		reset();

		printk("Scanning for broadcast sources\n");
		err = bt_audio_broadcast_sink_scan_start(BT_LE_SCAN_ACTIVE);
		if (err != 0) {
			printk("Unable to start scan for broadcast sources: %d\n",
			       err);
			return;
		}

		/* TODO: Update K_FOREVER with a sane value, and handle error */
		err = k_sem_take(&sem_broadcaster_found, SEM_TIMEOUT);
		if (err != 0) {
			printk("sem_broadcaster_found timed out, resetting\n");
			continue;
		}
		printk("Broadcast source found, waiting for PA sync\n");

		err = k_sem_take(&sem_pa_synced, SEM_TIMEOUT);
		if (err != 0) {
			printk("sem_pa_synced timed out, resetting\n");
			continue;
		}
		printk("Broadcast source PA synced, waiting for BASE\n");

		err = k_sem_take(&sem_base_received, SEM_TIMEOUT);
		if (err != 0) {
			printk("sem_base_received timed out, resetting\n");
			continue;
		}
		printk("BASE received, waiting for syncable\n");

		err = k_sem_take(&sem_syncable, SEM_TIMEOUT);
		if (err != 0) {
			printk("sem_syncable timed out, resetting\n");
			continue;
		}

		printk("Syncing to broadcast\n");
		err = bt_audio_broadcast_sink_sync(broadcast_sink,
						   bis_index_bitfield,
						   streams_p,
						   NULL);
		if (err != 0) {
			printk("Unable to sync to broadcast source: %d\n", err);
			return;
		}

		printk("Waiting for PA disconnected\n");
		k_sem_take(&sem_pa_sync_lost, K_FOREVER);
	}
}
```
